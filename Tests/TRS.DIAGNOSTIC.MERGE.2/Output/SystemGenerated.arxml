AUTOSAR XML (schema 4-2-2)
package /RootP_DcmDesc
  diagnostic service table VSM_ServicesTable:
    diagnostic-connections=ToBeDone
    ecu-instance=VSM
    protocol-kind=DCM_UDS_ON_CAN
    service-instance=[DID_DispoEtatMenuPrgPem_Read, DID_DispoEtatMenuReserveZEV_Read, DID_DispoMenuInfoXVV_Read, DID_DIURNES_VALEUR_DEFAUT_Read, DID_DIURNES_VALEUR_DEFAUT_Write, DID_EtatFctMenuParam_Read, DID_EtatMenuInfoParamDispo_Read, DID_EtatMenuInfoUniteLangueDispo_Read, DID_EtatMenuPrgMem_Read, DID_EtatMenuPrgMem_Write, DID_EtatMenuReserveZEV_Read, DID_EtatMenuUnitesLangue_Read, DID_EtatReglageButeesXVV_Read, DID_INIT_FARC_Read, DID_INIT_FARC_Write, DID_INIT_PRESENCE_ARC_Read, DID_INIT_PRESENCE_ARC_Write, DID_INIT_SENS_ARC_NIV_Read, DID_INIT_SENS_ARC_NIV_Write, DID_TYPE_MENU_PERSO_Read, DID_TYPE_MENU_PERSO_Write, DID_VitLVVDeMenuPerso_Read, DID_ACQUI_PRESENCE_PASS_Read, DID_ACQUI_PRESENCE_PASS_Write, DID_BARRETTE_TNB_SUR_LIN_Read, DID_BARRETTE_TNB_SUR_LIN_Write, DID_CLE_INHIB_AIRBAG_Read, DID_CLE_INHIB_AIRBAG_Write, DID_DefautPresenceConducteur_Read, DID_DETECTION_PRES_NB_PAR2C_Read, DID_DETECTION_PRES_NB_PAR2C_Write, DID_DETECTION_PRES_NB_PAR2D_Read, DID_DETECTION_PRES_NB_PAR2D_Write, DID_DETECTION_PRES_NB_PAR2G_Read, DID_DETECTION_PRES_NB_PAR2G_Write, DID_FlagDebouclCeintCond_Read, DID_FlagDebouclCeintPassAV_Read, DID_FlagDebouclCeintPavC_Read, DID_FlagDebouclCeintRang2Centre_Read, DID_FlagDebouclCeintRang2Droite_Read, DID_FlagDebouclCeintRang2Gauche_Read, DID_FlagDebouclCeintRang3Droite_Read, DID_FlagDebouclCeintRang3Gauche_Read, DID_INHIB_DIAG_TNB_COND_Read, DID_INHIB_DIAG_TNB_COND_Write, DID_INHIB_DIAG_TNB_PAR3_Read, DID_INHIB_DIAG_TNB_PAR3_Write, DID_INHIB_DIAG_TNB_PARC_Read, DID_INHIB_DIAG_TNB_PARC_Write, DID_INHIB_DIAG_TNB_PARD_Read, DID_INHIB_DIAG_TNB_PARD_Write, DID_INHIB_DIAG_TNB_PARG_Read, DID_INHIB_DIAG_TNB_PARG_Write, DID_INHIB_DIAG_TNB_PAV_Read, DID_INHIB_DIAG_TNB_PAV_Write, DID_NAPPE_DETECTION_PASS_Read, DID_NAPPE_DETECTION_PASS_Write, DID_NBR_CNB_Read, DID_NBR_CNB_Write, DID_OPTION_PAVC_PRES_DETECTION_Read, DID_OPTION_PAVC_PRES_DETECTION_Write, DID_OPTION_TAXI_Read, DID_OPTION_TAXI_Write, DID_PresenceConducteur_Read, DID_PRESENCE_ECR_Read, DID_PRESENCE_ECR_Write, Routine_RAZIndicDiagTNB]
