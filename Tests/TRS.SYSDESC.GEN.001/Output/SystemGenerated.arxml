AUTOSAR XML (schema 4-2-2)
package /RootP_SR_Data
  sender receiver interface SR_ApportCarbDetecteTest
    data ApportCarbDetecte: type=tLOG, init-value=CONST_tLOG_0:0
