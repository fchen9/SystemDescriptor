AUTOSAR XML (schema 4-2-2)
package /Pack_sw_Types
  impl type tBinaire: category=VALUE, base-type=uint8, compu-method=enum_tBinaire
