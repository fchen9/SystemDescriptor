AUTOSAR XML (schema 40_3)
package /RootP_NetworkDesc
  ecu instance AAD: associated-com-i-pdu-group=[IPDUGROUP_LS_APPLICATION_RX_E, IPDUGROUP_LS_APPLICATION_RX, IPDUGROUP_LS_APPLICATION_RX_F], sleep-mode-supported=false, wake-up-over-bus-supported=false
    can communication controller ctl_CAR
    can communication controller ctl_CONF
    can communication connector cc_AAD_CAR: comm-controller=ctl_CAR
    can communication connector cc_AAD_CONF: comm-controller=ctl_CONF
  system signal XVV_CONS_VIT_PROG_D1A9
  system signal AUTONOMIE_HS1_52E
