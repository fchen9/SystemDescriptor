AUTOSAR XML (schema 4-2-2)
package /RootP_Composition
  composition sw component type Compo_VSM
    component Instance_ASWC_A26: type=ASWC_A26
