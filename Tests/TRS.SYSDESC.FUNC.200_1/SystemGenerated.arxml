AUTOSAR XML (schema 4-2-2)
package /RootP_NetworkDesc
  system VSM_System: system-version=4.0.3
    root-software-compositions:
      root sw composition prototype RootCompositionVSM2: software-composition=Compo_VSM
      root sw composition prototype RootCompositionVSM: software-composition=Compo_VSM
    system mapping SystemMapping_ASWC_A26
      data-mappings:
        data-element=Instance_ASWC_A26.RootCompositionVSM.PRP_SR_Autonomie.Autonomie, system-signal=AUTONOMIE_HS1_52E
        data-element=Instance_ASWC_A26.RootCompositionVSM.PRP_SR_Autonomie.Autonomie, system-signal=AUTONOMIE_HS1_52E
      sw-impl-mappings:
        swc to ecu mapping SwImpMappingA26: component=[RootCompositionVSM.Instance_ASWC_A26, RootCompositionVSM.Instance_ASWC_A26], component-implementation=Implementatation_ASWC_A26
        swc to ecu mapping SwImpMappingA27: component=[RootCompositionVSM.Instance_ASWC_A24, RootCompositionVSM.Instance_ASWC_A24], component-implementation=Implementatation_ASWC_A26
      sw-mappings:
        swc to ecu mapping SwToEcuMapping: component=[RootCompositionVSM.Instance_ASWC_A26, RootCompositionVSM.Instance_ASWC_A26], ecu-instance=VSM
        swc to ecu mapping SwToEcuMapping3: component=[RootCompositionVSM.Instance_ASWC_A26, RootCompositionVSM.Instance_ASWC_A26], ecu-instance=VSM
package /RootP_Composition
  composition sw component type Compo_VSM
    component Instance_ASWC_A26: type=ASWC_A26
