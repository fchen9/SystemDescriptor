AUTOSAR XML (schema 4-2-2)
package /RootP_NV_Data
  16 x nv data interface:
    SR_ConsoAutonomieGM
      nv-datas:
        data ConsoAutonomieGM: type=tDWORD
    SR_ConsoMoyenneHY1
      nv-datas:
        data ConsoMoyenneHY1: type=tBYTE
    SR_ConsoMoyenneHY2
      nv-datas:
        data ConsoMoyenneHY2: type=tBYTE
    SR_ConsoMoyenneHY3
      nv-datas:
        data ConsoMoyenneHY3: type=tBYTE
    SR_ConsoMoyenneHY4
      nv-datas:
        data ConsoMoyenneHY4: type=tBYTE
    SR_ConsoMoyenneHY5
      nv-datas:
        data ConsoMoyenneHY5: type=tBYTE
    SR_ConsoMoyenneHY6
      nv-datas:
        data ConsoMoyenneHY6: type=tBYTE
    SR_Conso_WH_Gain1
      nv-datas:
        data Conso_WH_Gain1: type=tBYTE
    SR_Conso_WH_Gain2
      nv-datas:
        data Conso_WH_Gain2: type=tBYTE
    SR_Conso_WH_Gain3
      nv-datas:
        data Conso_WH_Gain3: type=tBYTE
    SR_Conso_WH_Gain4
      nv-datas:
        data Conso_WH_Gain4: type=tBYTE
    SR_Conso_WH_Gain5
      nv-datas:
        data Conso_WH_Gain5: type=tBYTE
    SR_Conso_WH_Gain6
      nv-datas:
        data Conso_WH_Gain6: type=tBYTE
    SR_DistAutonomieGM
      nv-datas:
        data DistAutonomieGM: type=tDWORD
    SR_SAV_ConsoGPLLisse
      nv-datas:
        data SAV_ConsoGPLLisse: type=tWORD
    SR_SAV_ConsoLisse
      nv-datas:
        data SAV_ConsoLisse: type=tWORD
