AUTOSAR XML (schema 4-2-1)
package /RootP_DiagDesc
  diagnostic contribution set DiagContributionSet: category=DIAGNOSTICS_ECU_EXTRACT
    elements:
      DID_AutonomieCalculee
      DID_AutonomieCalculee_Read
      DID_AutonomieGPL
      DID_AutonomieGPL_Read
      DID_ConsoInstantanee
      DID_ConsoInstantanee_Read
      DID_ConsoMoyenneHY1
      DID_ConsoMoyenneHY1_Read
      DID_ConsoMoyenneHY2
      DID_ConsoMoyenneHY2_Read
      DID_ConsoMoyenneHY3
      DID_ConsoMoyenneHY3_Read
      DID_ConsoMoyenneHY4
      DID_ConsoMoyenneHY4_Read
      DID_ConsoMoyenneHY5
      DID_ConsoMoyenneHY5_Read
      DID_ConsoMoyenneHY6
      DID_ConsoMoyenneHY6_Read
      DID_ConsoMoyTrajet1
      DID_ConsoMoyTrajet1_Read
      DID_ConsoMoyTrajet2
      DID_ConsoMoyTrajet2_Read
      DID_ConsoRapide
      DID_ConsoRapide_Read
      DID_PRESENCE_GAZ
      DID_PRESENCE_GAZ_Read
      DID_PRESENCE_GAZ_Write
      DID_PRESENCE_ODB
      DID_PRESENCE_ODB_Read
      DID_PRESENCE_ODB_Write
  14 x diagnostic data identifier:
    DID_AutonomieCalculee: id=55521
      diagnostic-parameter bit-offset=0:
        diagnostic data element dde_Autonomie: array-size-semantics=FIXED-SIZE, max-number-of-elements=1, implementation-data-type=tWORD
    DID_AutonomieGPL: id=56500
      diagnostic-parameter bit-offset=0:
        diagnostic data element dde_AutonomieGPL: array-size-semantics=FIXED-SIZE, max-number-of-elements=1, implementation-data-type=tWORD
    DID_ConsoInstantanee: id=55495
      diagnostic-parameter bit-offset=0:
        diagnostic data element dde_ConsoInst: array-size-semantics=FIXED-SIZE, max-number-of-elements=1, implementation-data-type=tWORD
    DID_ConsoMoyenneHY1: id=55524
      diagnostic-parameter bit-offset=0:
        diagnostic data element dde_ConsoMoyenneHY1: array-size-semantics=FIXED-SIZE, max-number-of-elements=1, implementation-data-type=tBYTE
    DID_ConsoMoyenneHY2: id=55525
      diagnostic-parameter bit-offset=0:
        diagnostic data element dde_ConsoMoyenneHY2: array-size-semantics=FIXED-SIZE, max-number-of-elements=1, implementation-data-type=tBYTE
    DID_ConsoMoyenneHY3: id=55526
      diagnostic-parameter bit-offset=0:
        diagnostic data element dde_ConsoMoyenneHY3: array-size-semantics=FIXED-SIZE, max-number-of-elements=1, implementation-data-type=tBYTE
    DID_ConsoMoyenneHY4: id=55527
      diagnostic-parameter bit-offset=0:
        diagnostic data element dde_ConsoMoyenneHY4: array-size-semantics=FIXED-SIZE, max-number-of-elements=1, implementation-data-type=tBYTE
    DID_ConsoMoyenneHY5: id=55528
      diagnostic-parameter bit-offset=0:
        diagnostic data element dde_ConsoMoyenneHY5: array-size-semantics=FIXED-SIZE, max-number-of-elements=1, implementation-data-type=tBYTE
    DID_ConsoMoyenneHY6: id=55529
      diagnostic-parameter bit-offset=0:
        diagnostic data element dde_ConsoMoyenneHY6: array-size-semantics=FIXED-SIZE, max-number-of-elements=1, implementation-data-type=tBYTE
    DID_ConsoMoyTrajet1: id=55496
      diagnostic-parameter bit-offset=0:
        diagnostic data element dde_ConsoMoyenneT1: array-size-semantics=FIXED-SIZE, max-number-of-elements=1, implementation-data-type=tWORD
    DID_ConsoMoyTrajet2: id=55497
      diagnostic-parameter bit-offset=0:
        diagnostic data element dde_ConsoMoyenneT2: array-size-semantics=FIXED-SIZE, max-number-of-elements=1, implementation-data-type=tWORD
    DID_ConsoRapide: id=55498
      diagnostic-parameter bit-offset=0:
        diagnostic data element dde_SAV_ConsoLisse: array-size-semantics=FIXED-SIZE, max-number-of-elements=1, implementation-data-type=tWORD
    DID_PRESENCE_GAZ: id=9166
      diagnostic-parameter bit-offset=0:
        diagnostic data element dde_CFG_PRESENCE_GAZ: array-size-semantics=FIXED-SIZE, max-number-of-elements=1, implementation-data-type=tLOG
    DID_PRESENCE_ODB: id=9115
      diagnostic-parameter bit-offset=0:
        diagnostic data element dde_CFG_PRESENCE_ODB: array-size-semantics=FIXED-SIZE, max-number-of-elements=1, implementation-data-type=tLOG
package /RootP_DcmDesc
  diagnostic service table VSM_ServicesTable:
    diagnostic-connections=ToBeDone
    ecu-instance=VSM
    protocol-kind=DCM_UDS_ON_CAN
    service-instance=[DID_AutonomieCalculee_Read, DID_AutonomieGPL_Read, DID_ConsoInstantanee_Read, DID_ConsoMoyenneHY1_Read, DID_ConsoMoyenneHY2_Read, DID_ConsoMoyenneHY3_Read, DID_ConsoMoyenneHY4_Read, DID_ConsoMoyenneHY5_Read, DID_ConsoMoyenneHY6_Read, DID_ConsoMoyTrajet1_Read, DID_ConsoMoyTrajet2_Read, DID_ConsoRapide_Read, DID_PRESENCE_GAZ_Read, DID_PRESENCE_GAZ_Write, DID_PRESENCE_ODB_Read, DID_PRESENCE_ODB_Write]
  13 x diagnostic read data by identifier, all with read-class=ReadDataByIdentifierClass:
    DID_AutonomieCalculee_Read: data-identifier=DID_AutonomieCalculee
    DID_AutonomieGPL_Read: data-identifier=DID_AutonomieGPL
    DID_ConsoInstantanee_Read: data-identifier=DID_ConsoInstantanee
    DID_ConsoMoyenneHY{1..6}_Read: data-identifier=DID_ConsoMoyenneHY{1..6}
    DID_ConsoMoyTrajet1_Read: data-identifier=DID_ConsoMoyTrajet1
    DID_ConsoMoyTrajet2_Read: data-identifier=DID_ConsoMoyTrajet2
    DID_ConsoRapide_Read: data-identifier=DID_ConsoRapide
    DID_PRESENCE_GAZ_Read: data-identifier=DID_PRESENCE_GAZ
  diagnostic write data by identifier DID_PRESENCE_GAZ_Write: data-identifier=DID_PRESENCE_GAZ, write-class=WriteDataByIdentifierClass
  diagnostic read data by identifier DID_PRESENCE_ODB_Read: data-identifier=DID_PRESENCE_ODB, read-class=ReadDataByIdentifierClass
  diagnostic write data by identifier DID_PRESENCE_ODB_Write: data-identifier=DID_PRESENCE_ODB, write-class=WriteDataByIdentifierClass
