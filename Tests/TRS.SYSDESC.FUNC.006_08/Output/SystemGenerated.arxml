AUTOSAR XML (schema 4-2-2)
package /RootP_SR_Data
  70 x sender receiver interface:
    SR_CMMMuet_P26
      data CMMMuet_P26: type=tFLOAT, init-value=CONST_tFLOAT_0:0
    SR_ConsommationCarbReelle_P26
      data ConsommationCarbReelle_P26: type=tBYTE, init-value=CONST_tBYTE_0:0
    SR_ConsommationGPL
      data ConsommationGPL: type=tBYTE, init-value=CONST_tBYTE_0:0
    SR_DdeRazDeOdometre
      data DdeRazDeOdometre: type=tLOG, init-value=CONST_tLOG_0:0
    SR_DdeRazT1_P26
      data DdeRazT1_P26: type=tLOG, init-value=CONST_tLOG_0:0
    SR_DdeRazT2_P26
      data DdeRazT2_P26: type=tLOG, init-value=CONST_tLOG_0:0
    SR_DefautJaugeCarbConfirme
      data DefautJaugeCarbConfirme: type=t_cSDF_Defaut, init-value=CONST_DefautJaugeCarbConfirme_t_cSDF_Defaut_cSDF_DefautAbsent:0x69
    SR_DistanceParcourue
      data DistanceParcourue: type=tWORD, init-value=CONST_tWORD_0:0
    SR_DistanceParcourueFigee
      data DistanceParcourueFigee: type=tLOG, init-value=CONST_tLOG_0:0
    SR_DistanceParcourueValide
      data DistanceParcourueValide: type=tLOG, init-value=CONST_tLOG_1:1
    SR_DistanceT1
      data DistanceT1: type=tWORD, init-value=CONST_tWORD_0:0
    SR_DistanceT2
      data DistanceT2: type=tWORD, init-value=CONST_tWORD_0:0
    SR_DysfVitesseVehicule
      data DysfVitesseVehicule: type=t_cVitv, init-value=CONST_t_cVitv_0:0
    SR_EtatGMP
      data EtatGMP: type=t_GM_GMP, init-value=CONST_t_GM_GMP_1:1
    SR_EtatGMPDeHY
      data EtatGMPDeHY: type=t_cGM_HY, init-value=CONST_t_cGM_HY_0:0
    SR_EtatModeGaz
      data EtatModeGaz: type=t_, init-value=CONST_t_7:7
    SR_EtatPrincipalSEV
      data EtatPrincipalSEV: type=t_SEV, init-value=CONST_t_SEV_0x69:0x69
    SR_GAZMuet_P26
      data GAZMuet_P26: type=tLOG, init-value=CONST_tLOG_0:0
    SR_GPLModeINFO
      data GPLModeINFO: type=t_e_0, init-value=CONST_t_e_0_0:0
    SR_GPLtankCapacity
      data GPLtankCapacity: type=tBYTE, init-value=CONST_tBYTE_0:0
    SR_ModeFonctMotGAZ
      data ModeFonctMotGAZ: type=t_cModeFonctMotGAZ, init-value=CONST_t_cModeFonctMotGAZ_0x07:0x07
    SR_NivGPLAffiche
      data NivGPLAffiche: type=tBYTE, init-value=CONST_tBYTE_0:0
    SR_PhaseVieLS
      data PhaseVieLS: type=t_cCANLS, init-value=CONST_t_cCANLS_0:0
    SR_PremiereMesureJC_OK
      data PremiereMesureJC_OK: type=t_cSDF_Mesure, init-value=CONST_PremiereMesureJC_OK_t_cSDF_Mesure_cSDF_MesureNonRealisee:0x69
    SR_PseudoConsommationCarb
      data PseudoConsommationCarb: type=tBYTE, init-value=CONST_tBYTE_0:0
    SR_QteEnergieRecup
      data QteEnergieRecup: type=tBYTE, init-value=CONST_tBYTE_0:0
    SR_RegimeMoteur_P26
      data RegimeMoteur_P26: type=tWORD, init-value=CONST_tWORD_0:0
    SR_SAV_DistancePreciseT1
      data SAV_DistancePreciseT1: type=tDWORD, init-value=CONST_tDWORD_0:0
    SR_SAV_DistancePreciseT2
      data SAV_DistancePreciseT2: type=tDWORD, init-value=CONST_tDWORD_0:0
    SR_SAV_EtatReseauElectrique
      data SAV_EtatReseauElectrique: type=t_cGEE_1, init-value=CONST_t_cGEE_1_0:0
    SR_SAV_NivCarbAffiche
      data SAV_NivCarbAffiche: type=tWORD, init-value=CONST_tWORD_0xFFFF:0xFFFF
    SR_VitesseVehicule
      data VitesseVehicule: type=tWORD, init-value=CONST_tWORD_0:0
    SR_ZoomConsoIHM
      data ZoomConsoIHM: type=tBILOG, init-value=CONST_tBILOG_0:0
    SR_Autonomie
      data Autonomie: type=tWORD, init-value=CONST_tWORD_0xFFFF:0xFFFF
    SR_AutonomieGPL
      data AutonomieGPL: type=tWORD, init-value=CONST_tWORD_0x7FF:0x7FF
    SR_AutonomieInvalide
      data AutonomieInvalide: type=tLOG, init-value=CONST_tLOG_0:0
    SR_AutonomieTOTAL
      data AutonomieTOTAL: type=tWORD, init-value=CONST_tWORD_0x7FF:0x7FF
    SR_ConsoAutonomieGM
      data ConsoAutonomieGM: type=tDWORD, init-value=CONST_tDWORD_0:0
    SR_ConsoGPLInvalide
      data ConsoGPLInvalide: type=tLOG, init-value=CONST_tLOG_0:0
    SR_ConsoInst
      data ConsoInst: type=tWORD, init-value=CONST_tWORD_0xFFFF:0xFFFF
    SR_ConsoInstGPL
      data ConsoInstGPL: type=tWORD, init-value=CONST_tWORD_0x1FF:0x1FF
    SR_ConsoLissee
      data ConsoLissee: type=tWORD, init-value=CONST_tWORD_0:0
    SR_ConsoMoyenneGPLT1
      data ConsoMoyenneGPLT1: type=tWORD, init-value=CONST_tWORD_0:0
    SR_ConsoMoyenneGPLT2
      data ConsoMoyenneGPLT2: type=tWORD, init-value=CONST_tWORD_0:0
    SR_ConsoMoyenneHY1
      data ConsoMoyenneHY1: type=tBYTE, init-value=CONST_tBYTE_0:0
    SR_ConsoMoyenneHY2
      data ConsoMoyenneHY2: type=tBYTE, init-value=CONST_tBYTE_0:0
    SR_ConsoMoyenneHY3
      data ConsoMoyenneHY3: type=tBYTE, init-value=CONST_tBYTE_0:0
    SR_ConsoMoyenneHY4
      data ConsoMoyenneHY4: type=tBYTE, init-value=CONST_tBYTE_0:0
    SR_ConsoMoyenneHY5
      data ConsoMoyenneHY5: type=tBYTE, init-value=CONST_tBYTE_0:0
    SR_ConsoMoyenneHY6
      data ConsoMoyenneHY6: type=tBYTE, init-value=CONST_tBYTE_0:0
    SR_ConsoMoyenneT1
      data ConsoMoyenneT1: type=tWORD, init-value=CONST_tWORD_0:0
    SR_ConsoMoyenneT2
      data ConsoMoyenneT2: type=tWORD, init-value=CONST_tWORD_0:0
    SR_ConsoReelleInvalide
      data ConsoReelleInvalide: type=tLOG, init-value=CONST_tLOG_0:0
    SR_Conso_WH_Gain1
      data Conso_WH_Gain1: type=tBYTE, init-value=CONST_tBYTE_0:0
    SR_Conso_WH_Gain2
      data Conso_WH_Gain2: type=tBYTE, init-value=CONST_tBYTE_0:0
    SR_Conso_WH_Gain3
      data Conso_WH_Gain3: type=tBYTE, init-value=CONST_tBYTE_0:0
    SR_Conso_WH_Gain4
      data Conso_WH_Gain4: type=tBYTE, init-value=CONST_tBYTE_0:0
    SR_Conso_WH_Gain5
      data Conso_WH_Gain5: type=tBYTE, init-value=CONST_tBYTE_0:0
    SR_Conso_WH_Gain6
      data Conso_WH_Gain6: type=tBYTE, init-value=CONST_tBYTE_0:0
    SR_DistAutonomieGM
      data DistAutonomieGM: type=tDWORD, init-value=CONST_tDWORD_0:0
    SR_NbDemiMedaillesBarre1
      data NbDemiMedaillesBarre1: type=tWORD, init-value=CONST_tWORD_0:0
    SR_NbDemiMedaillesBarre2
      data NbDemiMedaillesBarre2: type=tWORD, init-value=CONST_tWORD_0:0
    SR_NbDemiMedaillesBarre3
      data NbDemiMedaillesBarre3: type=tWORD, init-value=CONST_tWORD_0:0
    SR_NbDemiMedaillesBarre4
      data NbDemiMedaillesBarre4: type=tWORD, init-value=CONST_tWORD_0:0
    SR_NbDemiMedaillesBarre5
      data NbDemiMedaillesBarre5: type=tWORD, init-value=CONST_tWORD_0:0
    SR_NbDemiMedaillesBarre6
      data NbDemiMedaillesBarre6: type=tWORD, init-value=CONST_tWORD_0:0
    SR_PseudoConsoInvalide
      data PseudoConsoInvalide: type=tLOG, init-value=CONST_tLOG_0:0
    SR_RazOkDeAuCoVersOdo
      data RazOkDeAuCoVersOdo: type=tLOG, init-value=CONST_tLOG_0:0
    SR_SAV_ConsoGPLLisse
      data SAV_ConsoGPLLisse: type=tWORD, init-value=CONST_tWORD_100:100
    SR_SAV_ConsoLisse
      data SAV_ConsoLisse: type=tWORD, init-value=CONST_tWORD_100:100
package /Pack_sw_Types
  30 x impl type:
    t_cHProgPrecondTherm: category=VALUE, base-type=uint16, compu-method=enum_t_cHProgPrecondTherm
    t_: sw-calibration-access=READ-ONLY, compu {0x0=GAZ, 0x1=EssenceForcedGaz, 0x2=GazEssenceCommutation, 0x3=EssenceFocedWaitGazCondition, 0x4=GazForcedEssenceTankVide, 0x5=EssenceGazCommutation, 0x6=EssenceForcedGazTankVide, 0x7=Essence}, implementation-data-type=uint8
    tBinaire: sw-calibration-access=READ-ONLY, compu {0=cFaux, 1=cVrai}, implementation-data-type=boolean
    t_C26_ALT_FR_DISTANCE_SEED: sw-calibration-access=READ-ONLY, implementation-data-type=uint8
    t_C26_ALT_FR_FUEL_USED_SEED: sw-calibration-access=READ-ONLY, implementation-data-type=uint8
    t_C26_DISTANCE_MINI_HY: sw-calibration-access=READ-ONLY, implementation-data-type=uint16
    t_C26_FILTER_GM: sw-calibration-access=READ-ONLY, implementation-data-type=uint16
    t_C26_MAXDIST_GM: sw-calibration-access=READ-ONLY, implementation-data-type=uint8
    t_C26_MAXFUEL_GM: sw-calibration-access=READ-ONLY, implementation-data-type=uint8
    t_C26_RANGE_SCALEGPL: sw-calibration-access=READ-ONLY, implementation-data-type=uint16
    t_cCANLS: sw-calibration-access=READ-ONLY, compu {0x00=cCANLS_VEILLE, 0x01=cCANLS_NORMAL, 0x02=cCANLS_MISE_EN_VEILLE, 0x03=cCANLS_REVEIL, 0x04=cCANLS_COMOFF}, implementation-data-type=uint8
    t_cEtatHY: sw-calibration-access=READ-ONLY, compu {0=cEtatHY_Indetermine, 1=cEtatHY_Inactive, 2=cEtatHY_ActiveArret, 3=cEtatHY_ActiveTraction, 4=cEtatHY_ActivePropulsion, 5=cEtatHY_ActiveHybride}, implementation-data-type=uint8
    t_cGEE_1: sw-calibration-access=READ-ONLY, compu {0x00=cGEE_TI_Nominal, 0x01=cGEE_TI_Degrade, 0x02=cGEE_TI_DispoDem, 0x03=cGEE_Demarrage, 0x04=cGEE_Redemarrage, 0x05=cGEE_TA_Nominal, 0x06=cGEE_TA_Degrade, 0x07=cGEE_TA_Secu, 0x08=cGEE_TA_Urgence, 0xFE=cGEE_TI_Indisponible, 0xFF=cGEE_TI_Invalide}, implementation-data-type=uint8
    t_cGM_HY: sw-calibration-access=READ-ONLY, compu {0x0=cGM_HYIndetermine, 0x1=cGM_HYInactive, 0x2=cGM_HYActiveArret, 0x3=cGM_HYActiveTraction, 0x4=cGM_HYActivePropulsion, 0x5=cGM_HYActiveHybride, 0x6=cGM_HY_MAX}, implementation-data-type=uint8
    t_cIHM: sw-calibration-access=READ-ONLY, compu {0=cIHM_without, 1=cIHM_currentAutonomy, 2=cIHM_totalAutonomy}, implementation-data-type=uint8
    t_cModeFonctMotGAZ: sw-calibration-access=READ-ONLY, compu {0x00=cModeFonctMotGAZ_GAZ, 0x01=cModeFonctMotGAZ_GAZ_HS, 0x02=cModeFonctMotGAZ_CommutGAZ_Essence, 0x03=cModeFonctMotGAZ_AttenteGAZ, 0x04=cModeFonctMotGAZ_EssenceVide, 0x05=cModeFonctMotGAZ_CommutEssence_GAZ, 0x06=cModeFonctMotGAZ_GAZVide, 0x07=cModeFonctMotGAZ_Essence}, implementation-data-type=uint8
    t_cSDF_Defaut: sw-calibration-access=READ-ONLY, compu {0x69=cSDF_DefautAbsent, 0x96=cSDF_DefautPresent}, implementation-data-type=uint8
    t_cSDF_Mesure: sw-calibration-access=READ-ONLY, compu {0x69=cSDF_MesureNonRealisee, 0x96=cSDF_MesureRealisee}, implementation-data-type=uint8
    t_cTCT: sw-calibration-access=READ-ONLY, compu {0x00=cTCT_MTH, 0x01=cTCT_HY, 0x02=cTCT_ELEC}, implementation-data-type=uint8
    t_cVitv: sw-calibration-access=READ-ONLY, compu {0x5=cVitvIndispo, 0xA=cVitvDispo, 0xFFFF=cVitvInvalide, 1=cVitv_Incoherent, 1=cVitv_Coherent, 0xB=cVitv_cOK}, implementation-data-type=uint16
    t_e_0: sw-calibration-access=READ-ONLY, compu {0x0=cMode_Essence, 0x1=cMode_GPL, 0x2=cBasculement_en_cours, 0x3=cInvalideEssenceGPL}, implementation-data-type=uint8
    t_GM_GMP: sw-calibration-access=READ-ONLY, compu {0x00=GM_GMPInit, 0x01=GM_GMPCoupe, 0x02=GM_GMPEnDemarrage, 0x04=GM_GMPTournant, 0x08=GM_GMPArrete, 0x10=GM_GMPEnRedemarrage, 0x20=GM_GMPTournantHybride, 0x40=GM_GMPTournantElecPur, 0x80=GM_GMPEnPreparation}, implementation-data-type=uint8
    t_H: sw-calibration-access=READ-ONLY, compu {0=cPHASE_1, 1=cPHASE_2, 2=cHY_E35, 3=cHY4_PREMIUM, 4=cPHEV}, implementation-data-type=uint8
    t_SEV: sw-calibration-access=READ-ONLY, compu {0x69=SEV_Arret, 0x96=SEV_Contact, 0x3C=SEV_Demarreur}, implementation-data-type=uint8
    t_T26_TEMPO_HISTO_HY: sw-calibration-access=READ-ONLY, implementation-data-type=uint16
    t_T26_TEMPO_HISTO_ZOOM{1..4}: sw-calibration-access=READ-ONLY, implementation-data-type=uint8
    t_VAL_MEDAILLE: sw-calibration-access=READ-ONLY, implementation-data-type=uint8
package /RootP_NetworkDesc
  system VSM_System: system-version=4.0.3
    root-software-compositions:
      root sw composition prototype RootCompositionVSM: software-composition=Compo_VSM
package /RootP_Composition
  composition sw component type Compo_VSM
    component Instance_ASWC_A26: type=ASWC_A26
