AUTOSAR XML (schema 4-2-2)
package /RootP_NetworkDesc
  system VSM_System: system-version=4.0.3
    root-software-compositions:
      root sw composition prototype RootCompositionVSM: software-composition=Compo_VSMTest
      root sw composition prototype RootCompositionVSMTest: software-composition=Compo_VSM
package /RootP_Composition
  composition sw component type Compo_VSM
    component Instance_ASWC_A26: type=ASWC_A26
