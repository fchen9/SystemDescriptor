AUTOSAR XML (schema 4-2-2)
package /Pack_sw_Types
  compu method enum_tBinaire: 0=cFaux, 1=cVrai
