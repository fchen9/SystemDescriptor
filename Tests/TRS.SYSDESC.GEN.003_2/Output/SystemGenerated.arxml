AUTOSAR XML (schema 4-2-2)
package /RootP_NetworkDesc
  system VSM_System: system-version=4.0.3
    system mapping SystemMapping_ASWC_A26
      data-mappings:
        data-element=Instance_ASWC_A26.RootCompositionVSM.PRP_SR_Autonomie.Autonomie, system-signal=AUTONOMIE_HS1_52E
        data-element=Instance_ASWC_A126.RootCompositionVSM.PRP_SR_Autonomie.Autonomie, system-signal=AUTONOMIE_HS1_52E
    root-software-compositions:
      root sw composition prototype RootCompositionVSM: software-composition=Compo_VSM
package /RootP_Composition
  composition sw component type Compo_VSM
    component Instance_ASWC_A26: type=ASWC_A26
