AUTOSAR XML (schema 4-2-1)
package /RootP_DiagDesc
  diagnostic contribution set DiagContributionSet: category=DIAGNOSTICS_ECU_EXTRACT
    elements:
      DID_DispoEtatMenuPrgPem
      DID_DispoEtatMenuPrgPem_Read
      DID_DispoEtatMenuReserveZEV
      DID_DispoEtatMenuReserveZEV_Read
      DID_DispoMenuInfoXVV
      DID_DispoMenuInfoXVV_Read
      DID_DIURNES_VALEUR_DEFAUT
      DID_DIURNES_VALEUR_DEFAUT_Read
      DID_DIURNES_VALEUR_DEFAUT_Write
      DID_EtatFctMenuParam
      DID_EtatFctMenuParam_Read
      DID_EtatMenuInfoParamDispo
      DID_EtatMenuInfoParamDispo_Read
      DID_EtatMenuInfoUniteLangueDispo
      DID_EtatMenuInfoUniteLangueDispo_Read
      DID_EtatMenuPrgMem
      DID_EtatMenuPrgMem_Read
      DID_EtatMenuPrgMem_Write
      DID_EtatMenuReserveZEV
      DID_EtatMenuReserveZEV_Read
      DID_EtatMenuUnitesLangue
      DID_EtatMenuUnitesLangue_Read
      DID_EtatReglageButeesXVV
      DID_EtatReglageButeesXVV_Read
      DID_INIT_FARC
      DID_INIT_FARC_Read
      DID_INIT_FARC_Write
      DID_INIT_PRESENCE_ARC
      DID_INIT_PRESENCE_ARC_Read
      DID_INIT_PRESENCE_ARC_Write
      DID_INIT_SENS_ARC_NIV
      DID_INIT_SENS_ARC_NIV_Read
      DID_INIT_SENS_ARC_NIV_Write
      DID_TYPE_MENU_PERSO
      DID_TYPE_MENU_PERSO_Read
      DID_TYPE_MENU_PERSO_Write
      DID_VitLVVDeMenuPerso
      DID_VitLVVDeMenuPerso_Read
  16 x diagnostic data identifier:
    DID_DispoEtatMenuPrgPem: id=55562
      diagnostic-parameter bit-offset=0:
        diagnostic data element dde_DispoEtatMenuPrgPem: array-size-semantics=FIXED-SIZE, max-number-of-elements=1, implementation-data-type=tLOG
    DID_DispoEtatMenuReserveZEV: id=55564
      diagnostic-parameter bit-offset=0:
        diagnostic data element dde_DispoEtatMenuReserveZEV: array-size-semantics=FIXED-SIZE, max-number-of-elements=1, implementation-data-type=tLOG
    DID_DispoMenuInfoXVV: id=55517
      diagnostic-parameter bit-offset=0:
        diagnostic data element dde_EtatMenuInfoXVVDispo: array-size-semantics=FIXED-SIZE, max-number-of-elements=1, implementation-data-type=tLOG
    DID_DIURNES_VALEUR_DEFAUT: id=9004
      diagnostic-parameter bit-offset=0:
        diagnostic data element dde_CFG_INIT_ECL_FEUX_DIURNES: array-size-semantics=FIXED-SIZE, max-number-of-elements=1, implementation-data-type=tLOG
    DID_EtatFctMenuParam: id=55516
      diagnostic-parameter bit-offset=0:
        diagnostic data element dde_EtatMenuAccueilCond: array-size-semantics=FIXED-SIZE, max-number-of-elements=1, implementation-data-type=tLOG
      diagnostic-parameter bit-offset=0:
        diagnostic data element dde_EtatMenuARCSensNiv: array-size-semantics=FIXED-SIZE, max-number-of-elements=1, implementation-data-type=tBILOG
      diagnostic-parameter bit-offset=0:
        diagnostic data element dde_EtatMenuEclAccomp: array-size-semantics=FIXED-SIZE, max-number-of-elements=1, implementation-data-type=tLOG
      diagnostic-parameter bit-offset=0:
        diagnostic data element dde_EtatMenuEclAccompTempo: array-size-semantics=FIXED-SIZE, max-number-of-elements=1, implementation-data-type=tBILOG
      diagnostic-parameter bit-offset=0:
        diagnostic data element dde_EtatMenuEclAdapt: array-size-semantics=FIXED-SIZE, max-number-of-elements=1, implementation-data-type=tLOG
      diagnostic-parameter bit-offset=0:
        diagnostic data element dde_EtatMenuEclAmbi: array-size-semantics=FIXED-SIZE, max-number-of-elements=1, implementation-data-type=tLOG
      diagnostic-parameter bit-offset=0:
        diagnostic data element dde_EtatMenuEclAmbiNiv: array-size-semantics=FIXED-SIZE, max-number-of-elements=1, implementation-data-type=tBYTE
      diagnostic-parameter bit-offset=0:
        diagnostic data element dde_EtatMenuEclAuto: array-size-semantics=FIXED-SIZE, max-number-of-elements=1, implementation-data-type=tLOG
      diagnostic-parameter bit-offset=0:
        diagnostic data element dde_EtatMenuEclAutoroute: array-size-semantics=FIXED-SIZE, max-number-of-elements=1, implementation-data-type=tLOG
      diagnostic-parameter bit-offset=0:
        diagnostic data element dde_EtatMenuEclDeconda: array-size-semantics=FIXED-SIZE, max-number-of-elements=1, implementation-data-type=tLOG
      diagnostic-parameter bit-offset=0:
        diagnostic data element dde_EtatMenuEclDecondaTempo: array-size-semantics=FIXED-SIZE, max-number-of-elements=1, implementation-data-type=tBILOG
      diagnostic-parameter bit-offset=0:
        diagnostic data element dde_EtatMenuEssuiVitMar: array-size-semantics=FIXED-SIZE, max-number-of-elements=1, implementation-data-type=tLOG
      diagnostic-parameter bit-offset=0:
        diagnostic data element dde_EtatMenuFARC: array-size-semantics=FIXED-SIZE, max-number-of-elements=1, implementation-data-type=tLOG
      diagnostic-parameter bit-offset=0:
        diagnostic data element dde_EtatMenuFeuxDiurne: array-size-semantics=FIXED-SIZE, max-number-of-elements=1, implementation-data-type=tLOG
      diagnostic-parameter bit-offset=0:
        diagnostic data element dde_EtatMenuFSEAuto: array-size-semantics=FIXED-SIZE, max-number-of-elements=1, implementation-data-type=tLOG
      diagnostic-parameter bit-offset=0:
        diagnostic data element dde_EtatMenuMotoVolAr: array-size-semantics=FIXED-SIZE, max-number-of-elements=1, implementation-data-type=tLOG
      diagnostic-parameter bit-offset=0:
        diagnostic data element dde_EtatMenuPresenceARC: array-size-semantics=FIXED-SIZE, max-number-of-elements=1, implementation-data-type=tLOG
      diagnostic-parameter bit-offset=0:
        diagnostic data element dde_EtatMenuSelecArriere: array-size-semantics=FIXED-SIZE, max-number-of-elements=1, implementation-data-type=tLOG
      diagnostic-parameter bit-offset=0:
        diagnostic data element dde_EtatMenuSelecCabine: array-size-semantics=FIXED-SIZE, max-number-of-elements=1, implementation-data-type=tLOG
      diagnostic-parameter bit-offset=0:
        diagnostic data element dde_EtatMenuSelecOuvPlip: array-size-semantics=FIXED-SIZE, max-number-of-elements=1, implementation-data-type=tLOG
      diagnostic-parameter bit-offset=0:
        diagnostic data element dde_EtatMenuSonPoly: array-size-semantics=FIXED-SIZE, max-number-of-elements=1, implementation-data-type=tBILOG
      diagnostic-parameter bit-offset=0:
        diagnostic data element dde_EtatMenuStatusAAS: array-size-semantics=FIXED-SIZE, max-number-of-elements=1, implementation-data-type=tLOG
      diagnostic-parameter bit-offset=0:
        diagnostic data element dde_EtatMenuStatusSAM: array-size-semantics=FIXED-SIZE, max-number-of-elements=1, implementation-data-type=tLOG
      diagnostic-parameter bit-offset=0:
        diagnostic data element dde_EtatMenuTCFG: array-size-semantics=FIXED-SIZE, max-number-of-elements=1, implementation-data-type=tBYTE
    DID_EtatMenuInfoParamDispo: id=55515
      diagnostic-parameter bit-offset=0:
        diagnostic data element dde_EtatMenuInfoParamDispo: array-size-semantics=FIXED-SIZE, max-number-of-elements=1, implementation-data-type=tLOG
    DID_EtatMenuInfoUniteLangueDispo: id=55519
      diagnostic-parameter bit-offset=0:
        diagnostic data element dde_EtatMenuInfoUniteLangueDispo: array-size-semantics=FIXED-SIZE, max-number-of-elements=1, implementation-data-type=tLOG
    DID_EtatMenuPrgMem: id=55561
      diagnostic-parameter bit-offset=0:
        diagnostic data element dde_DmdMenuSelPrgDi: array-size-semantics=FIXED-SIZE, max-number-of-elements=1, implementation-data-type=tLOG
      diagnostic-parameter bit-offset=0:
        diagnostic data element dde_DmdMenuSelPrgJe: array-size-semantics=FIXED-SIZE, max-number-of-elements=1, implementation-data-type=tLOG
      diagnostic-parameter bit-offset=0:
        diagnostic data element dde_DmdMenuSelPrgLu: array-size-semantics=FIXED-SIZE, max-number-of-elements=1, implementation-data-type=tLOG
      diagnostic-parameter bit-offset=0:
        diagnostic data element dde_DmdMenuSelPrgMa: array-size-semantics=FIXED-SIZE, max-number-of-elements=1, implementation-data-type=tLOG
      diagnostic-parameter bit-offset=0:
        diagnostic data element dde_DmdMenuSelPrgMe: array-size-semantics=FIXED-SIZE, max-number-of-elements=1, implementation-data-type=tLOG
      diagnostic-parameter bit-offset=0:
        diagnostic data element dde_DmdMenuSelPrgSa: array-size-semantics=FIXED-SIZE, max-number-of-elements=1, implementation-data-type=tLOG
      diagnostic-parameter bit-offset=0:
        diagnostic data element dde_DmdMenuSelPrgVe: array-size-semantics=FIXED-SIZE, max-number-of-elements=1, implementation-data-type=tLOG
    DID_EtatMenuReserveZEV: id=55563
      diagnostic-parameter bit-offset=0:
        diagnostic data element dde_EtatMenuReserveZEV: array-size-semantics=FIXED-SIZE, max-number-of-elements=1, implementation-data-type=tLOG
    DID_EtatMenuUnitesLangue: id=55520
      diagnostic-parameter bit-offset=0:
        diagnostic data element dde_EtatMenuLangueVehicule: array-size-semantics=FIXED-SIZE, max-number-of-elements=1, implementation-data-type=tBYTE
      diagnostic-parameter bit-offset=0:
        diagnostic data element dde_EtatMenuUniteConso: array-size-semantics=FIXED-SIZE, max-number-of-elements=1, implementation-data-type=tLOG
      diagnostic-parameter bit-offset=0:
        diagnostic data element dde_EtatMenuUniteDistance: array-size-semantics=FIXED-SIZE, max-number-of-elements=1, implementation-data-type=tLOG
      diagnostic-parameter bit-offset=0:
        diagnostic data element dde_EtatMenuUniteTemperature: array-size-semantics=FIXED-SIZE, max-number-of-elements=1, implementation-data-type=tLOG
      diagnostic-parameter bit-offset=0:
        diagnostic data element dde_EtatMenuUniteVolume: array-size-semantics=FIXED-SIZE, max-number-of-elements=1, implementation-data-type=tLOG
    DID_EtatReglageButeesXVV: id=55518
      diagnostic-parameter bit-offset=0:
        diagnostic data element dde_EtatMenuActButee1XVV: array-size-semantics=FIXED-SIZE, max-number-of-elements=1, implementation-data-type=tLOG
      diagnostic-parameter bit-offset=0:
        diagnostic data element dde_EtatMenuActButee2XVV: array-size-semantics=FIXED-SIZE, max-number-of-elements=1, implementation-data-type=tLOG
      diagnostic-parameter bit-offset=0:
        diagnostic data element dde_EtatMenuActButee3XVV: array-size-semantics=FIXED-SIZE, max-number-of-elements=1, implementation-data-type=tLOG
      diagnostic-parameter bit-offset=0:
        diagnostic data element dde_EtatMenuActButee4XVV: array-size-semantics=FIXED-SIZE, max-number-of-elements=1, implementation-data-type=tLOG
      diagnostic-parameter bit-offset=0:
        diagnostic data element dde_EtatMenuActButee5XVV: array-size-semantics=FIXED-SIZE, max-number-of-elements=1, implementation-data-type=tLOG
      diagnostic-parameter bit-offset=0:
        diagnostic data element dde_EtatMenuActButeeGenXVV: array-size-semantics=FIXED-SIZE, max-number-of-elements=1, implementation-data-type=tLOG
      diagnostic-parameter bit-offset=0:
        diagnostic data element dde_EtatMenuVitesse1XVV: array-size-semantics=FIXED-SIZE, max-number-of-elements=1, implementation-data-type=tBYTE
      diagnostic-parameter bit-offset=0:
        diagnostic data element dde_EtatMenuVitesse2XVV: array-size-semantics=FIXED-SIZE, max-number-of-elements=1, implementation-data-type=tBYTE
      diagnostic-parameter bit-offset=0:
        diagnostic data element dde_EtatMenuVitesse3XVV: array-size-semantics=FIXED-SIZE, max-number-of-elements=1, implementation-data-type=tBYTE
      diagnostic-parameter bit-offset=0:
        diagnostic data element dde_EtatMenuVitesse4XVV: array-size-semantics=FIXED-SIZE, max-number-of-elements=1, implementation-data-type=tBYTE
      diagnostic-parameter bit-offset=0:
        diagnostic data element dde_EtatMenuVitesse5XVV: array-size-semantics=FIXED-SIZE, max-number-of-elements=1, implementation-data-type=tBYTE
    DID_INIT_FARC: id=9204
      diagnostic-parameter bit-offset=0:
        diagnostic data element dde_CFG_INIT_FARC: array-size-semantics=FIXED-SIZE, max-number-of-elements=1, implementation-data-type=tLOG
    DID_INIT_PRESENCE_ARC: id=9202
      diagnostic-parameter bit-offset=0:
        diagnostic data element dde_CFG_INIT_PRESENCE_ARC: array-size-semantics=FIXED-SIZE, max-number-of-elements=1, implementation-data-type=tLOG
    DID_INIT_SENS_ARC_NIV: id=9203
      diagnostic-parameter bit-offset=0:
        diagnostic data element dde_CFG_INIT_SENS_ARC_NIV: array-size-semantics=FIXED-SIZE, max-number-of-elements=1, implementation-data-type=t_CFG_INIT_SENS_ARC_NIV
    DID_TYPE_MENU_PERSO: id=8994
      diagnostic-parameter bit-offset=0:
        diagnostic data element dde_CFG_PRESENCE_MENU_PERSO: array-size-semantics=FIXED-SIZE, max-number-of-elements=1, implementation-data-type=tBYTE
    DID_VitLVVDeMenuPerso: id=55552
      diagnostic-parameter bit-offset=0:
        diagnostic data element dde_EtatMenuVitLvv1: array-size-semantics=FIXED-SIZE, max-number-of-elements=1, implementation-data-type=tBYTE
      diagnostic-parameter bit-offset=0:
        diagnostic data element dde_EtatMenuVitLvv2: array-size-semantics=FIXED-SIZE, max-number-of-elements=1, implementation-data-type=tBYTE
      diagnostic-parameter bit-offset=0:
        diagnostic data element dde_EtatMenuVitLvv3: array-size-semantics=FIXED-SIZE, max-number-of-elements=1, implementation-data-type=tBYTE
      diagnostic-parameter bit-offset=0:
        diagnostic data element dde_EtatMenuVitLvv4: array-size-semantics=FIXED-SIZE, max-number-of-elements=1, implementation-data-type=tBYTE
      diagnostic-parameter bit-offset=0:
        diagnostic data element dde_EtatMenuVitLvv5: array-size-semantics=FIXED-SIZE, max-number-of-elements=1, implementation-data-type=tBYTE
      diagnostic-parameter bit-offset=0:
        diagnostic data element dde_EtatMenuVitLvv6: array-size-semantics=FIXED-SIZE, max-number-of-elements=1, implementation-data-type=tBYTE
package /RootP_DcmDesc
  diagnostic service table VSM_ServicesTable:
    diagnostic-connections=ToBeDone
    ecu-instance=VSM
    protocol-kind=DCM_UDS_ON_CAN
    service-instance=[DID_DispoEtatMenuPrgPem_Read, DID_DispoEtatMenuReserveZEV_Read, DID_DispoMenuInfoXVV_Read, DID_DIURNES_VALEUR_DEFAUT_Read, DID_DIURNES_VALEUR_DEFAUT_Write, DID_EtatFctMenuParam_Read, DID_EtatMenuInfoParamDispo_Read, DID_EtatMenuInfoUniteLangueDispo_Read, DID_EtatMenuPrgMem_Read, DID_EtatMenuPrgMem_Write, DID_EtatMenuReserveZEV_Read, DID_EtatMenuUnitesLangue_Read, DID_EtatReglageButeesXVV_Read, DID_INIT_FARC_Read, DID_INIT_FARC_Write, DID_INIT_PRESENCE_ARC_Read, DID_INIT_PRESENCE_ARC_Write, DID_INIT_SENS_ARC_NIV_Read, DID_INIT_SENS_ARC_NIV_Write, DID_TYPE_MENU_PERSO_Read, DID_TYPE_MENU_PERSO_Write, DID_VitLVVDeMenuPerso_Read]
  4 x diagnostic read data by identifier, all with read-class=ReadDataByIdentifierClass:
    DID_DispoEtatMenuPrgPem_Read: data-identifier=DID_DispoEtatMenuPrgPem
    DID_DispoEtatMenuReserveZEV_Read: data-identifier=DID_DispoEtatMenuReserveZEV
    DID_DispoMenuInfoXVV_Read: data-identifier=DID_DispoMenuInfoXVV
    DID_DIURNES_VALEUR_DEFAUT_Read: data-identifier=DID_DIURNES_VALEUR_DEFAUT
  diagnostic write data by identifier DID_DIURNES_VALEUR_DEFAUT_Write: data-identifier=DID_DIURNES_VALEUR_DEFAUT, write-class=WriteDataByIdentifierClass
  4 x diagnostic read data by identifier, all with read-class=ReadDataByIdentifierClass:
    DID_EtatFctMenuParam_Read: data-identifier=DID_EtatFctMenuParam
    DID_EtatMenuInfoParamDispo_Read: data-identifier=DID_EtatMenuInfoParamDispo
    DID_EtatMenuInfoUniteLangueDispo_Read: data-identifier=DID_EtatMenuInfoUniteLangueDispo
    DID_EtatMenuPrgMem_Read: data-identifier=DID_EtatMenuPrgMem
  diagnostic write data by identifier DID_EtatMenuPrgMem_Write: data-identifier=DID_EtatMenuPrgMem, write-class=WriteDataByIdentifierClass
  4 x diagnostic read data by identifier, all with read-class=ReadDataByIdentifierClass:
    DID_EtatMenuReserveZEV_Read: data-identifier=DID_EtatMenuReserveZEV
    DID_EtatMenuUnitesLangue_Read: data-identifier=DID_EtatMenuUnitesLangue
    DID_EtatReglageButeesXVV_Read: data-identifier=DID_EtatReglageButeesXVV
    DID_INIT_FARC_Read: data-identifier=DID_INIT_FARC
  diagnostic write data by identifier DID_INIT_FARC_Write: data-identifier=DID_INIT_FARC, write-class=WriteDataByIdentifierClass
  diagnostic read data by identifier DID_INIT_PRESENCE_ARC_Read: data-identifier=DID_INIT_PRESENCE_ARC, read-class=ReadDataByIdentifierClass
  diagnostic write data by identifier DID_INIT_PRESENCE_ARC_Write: data-identifier=DID_INIT_PRESENCE_ARC, write-class=WriteDataByIdentifierClass
  diagnostic read data by identifier DID_INIT_SENS_ARC_NIV_Read: data-identifier=DID_INIT_SENS_ARC_NIV, read-class=ReadDataByIdentifierClass
  diagnostic write data by identifier DID_INIT_SENS_ARC_NIV_Write: data-identifier=DID_INIT_SENS_ARC_NIV, write-class=WriteDataByIdentifierClass
  diagnostic read data by identifier DID_TYPE_MENU_PERSO_Read: data-identifier=DID_TYPE_MENU_PERSO, read-class=ReadDataByIdentifierClass
  diagnostic write data by identifier DID_TYPE_MENU_PERSO_Write: data-identifier=DID_TYPE_MENU_PERSO, write-class=WriteDataByIdentifierClass
  diagnostic read data by identifier DID_VitLVVDeMenuPerso_Read: data-identifier=DID_VitLVVDeMenuPerso, read-class=ReadDataByIdentifierClass
