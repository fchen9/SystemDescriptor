AUTOSAR XML (schema 4-2-2)
package /RootP_Diag
  diagnostic write data by identifier DID_DIURNES_VALEUR_DEFAUT_Write: access-permission=AP_All, data-identifier=DID_ADCBSIVierge, write-class=WriteDataByIdentifierClass
  diagnostic write data by identifier DID_ACQUI_PRESENCE_PASS_Write: access-permission=AP_All, data-identifier=DID_CleReconnue, write-class=WriteDataByIdentifierClass
  diagnostic read data by identifier DID_DefautPresenceConducteur_Read: access-permission=AP_All, data-identifier=DID_NbNPTAesAppris, write-class=WriteDataByIdentifierClass
  diagnostic read data by identifier DID_RESERVOIR_VIDE_Read: access-permission=AP_All, data-identifier=DID_NbPMLAesAppris, write-class=WriteDataByIdentifierClass
  diagnostic write data by identifier DID_LOI_JAUGE_NIV_ALERTE_Write: access-permission=AP_All, data-identifier=DID_NbrTrspAppris, write-class=WriteDataByIdentifierClass
  diagnostic read data by identifier DID_TYPE_FAP_Read: access-permission=AP_All, data-identifier=DID_OPTION_WLC, write-class=WriteDataByIdentifierClass
