AUTOSAR XML (schema 4-2-2)
package /RootP_DcmDesc
  diagnostic service table VSM_ServicesTable: diagnostic-connections=ToBeDone, ecu-instance=VSM, protocol-kind=DCM_UDS_ON_CAN, service-instance=[DID_DIURNES_VALEUR_DEFAUT_Write, Routine_RAZIndicDiagTNB, DID_ACQUI_PRESENCE_PASS_Write, DID_DefautPresenceConducteur_Read]
