AUTOSAR XML (schema 4-2-2)
package /RootP_NetworkDesc
  system VSM_System: system-version=4.0.3
    system mapping SystemMapping
      sw-mappings:
        swc to ecu mapping SwToEcuMapping8: component=[RootCompositionVSM.Instance_ASWC_A28, RootCompositionVSM.Instance_ASWC_A26], ecu-instance=VSM
    root-software-compositions:
      root sw composition prototype RootCompositionVSM: software-composition=Compo_VSM
package /RootP_Composition
  composition sw component type Compo_VSM
    component Instance_ASWC_A28: type=ASWC_A28
    component Instance_ASWC_A26: type=ASWC_A26
